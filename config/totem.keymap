#include <behaviors.dtsi>
#include <dt-bindings/zmk/keys.h>
#include <dt-bindings/zmk/bt.h>
#include <dt-bindings/zmk/outputs.h>

#include "key_labels.dtsi"
#include "key_aliases.dtsi"

#define BASE 0
#define NAV 1
#define NUM 2
#define SYM 3
#define BRAC 4
#define FUN 5

/ {
    behaviors {
        #include "behaviors.dtsi"
    };
};

/ {
    #include "combos.dtsi"

    #include "macros.dtsi"

        keymap {
                compatible = "zmk,keymap";
                #include "layers/0_base.dtsi"
                #include "layers/1_nav.dtsi"
                #include "layers/2_num.dtsi"
                #include "layers/3_sym.dtsi"
                #include "layers/4_brac.dtsi"
                #include "layers/5_fun.dtsi"
        };
};
