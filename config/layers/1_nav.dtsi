nav_layer {
label = "NAV";
    bindings = <
//                       ╭─────────────┬─────────────┬─────────────┬─────────────┬─────────────╮   ╭─────────────┬─────────────┬─────────────┬─────────────┬─────────────╮
                           XXX           XXX           XXX           XXX           XXX               XXX           &kp HOME      &kp PG_DN     &kp PG_UP     &kp END
//                       ├─────────────┼─────────────┼─────────────┼─────────────┼─────────────┤   ├─────────────┼─────────────┼─────────────┼─────────────┼─────────────┤
                           &kp LCTRL     &kp LALT      &kp LGUI      &kp LSHFT     LHPR              XXX           &kp LEFT      &kp DOWN      &kp UP        &kp RIGHT
//         ╭─────────────┼─────────────┼─────────────┼─────────────┼─────────────┼─────────────┤   ├─────────────┼─────────────┼─────────────┼─────────────┼─────────────┼─────────────╮
             XXX           XXX           XXX           XXX           XXX           XXX               XXX           XXX           XXX           XXX           XXX           XXX
//         ╰─────────────┴─────────────┴─────────────┼─────────────┼─────────────┼─────────────┤   ├─────────────┼─────────────┼─────────────┼─────────────┴─────────────┴─────────────╯
                                                       XXX           XXX           XXX               &kp BSPC      &kp SPACE     ___
//                                                   ╰─────────────┴─────────────┴─────────────╯   ╰─────────────┴─────────────┴─────────────╯
    >;
};
