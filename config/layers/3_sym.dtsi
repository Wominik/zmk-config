sym_layer {
label = "SYM";
    bindings = <
//                       ╭─────────────┬─────────────┬─────────────┬─────────────┬─────────────╮   ╭─────────────┬─────────────┬─────────────┬─────────────┬─────────────╮
                           XXX           XXX           XXX           XXX           XXX               XXX           &kp AMPS      &kp STAR      &kp UNDER     &kp MINUS 
//                       ├─────────────┼─────────────┼─────────────┼─────────────┼─────────────┤   ├─────────────┼─────────────┼─────────────┼─────────────┼─────────────┤
                           &kp LGUI      &kp LALT      &kp LCTRL     &kp LSHFT     LHPR              XXX           &kp DLLR      &kp PRCNT     &kp CARET     &kp PLUS
//         ╭─────────────┼─────────────┼─────────────┼─────────────┼─────────────┼─────────────┤   ├─────────────┼─────────────┼─────────────┼─────────────┼─────────────┼─────────────╮
             XXX           XXX           XXX           XXX           XXX           XXX               XXX           &kp EXCL      &kp AT        &kp HASH      &kp PIPE      &kp EQUAL
//         ╰─────────────┴─────────────┴─────────────┼─────────────┼─────────────┼─────────────┤   ├─────────────┼─────────────┼─────────────┼─────────────┴─────────────┴─────────────╯
                                                       XXX           XXX           XXX               &kp BSPC      &kp SPACE     ___
//                                                   ╰─────────────┴─────────────┴─────────────╯   ╰─────────────┴─────────────┴─────────────╯
    >;
};
