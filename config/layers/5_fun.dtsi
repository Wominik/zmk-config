num_layer {
label = "FUN";
    bindings = <
//                       ╭─────────────┬─────────────┬─────────────┬─────────────┬─────────────╮   ╭─────────────┬─────────────┬─────────────┬─────────────┬─────────────╮
                           &kp F12       &kp F7        &kp F8        &kp F9        XXX               XXX           XXX           XXX           XXX           XXX 
//                       ├─────────────┼─────────────┼─────────────┼─────────────┼─────────────┤   ├─────────────┼─────────────┼─────────────┼─────────────┼─────────────┤
                           &kp F11       &kp F4        &kp F5        &kp F6        XXX               RHPR          &kp RSHFT     &kp RCTRL     &kp LALT      &kp LGUI
//         ╭─────────────┼─────────────┼─────────────┼─────────────┼─────────────┼─────────────┤   ├─────────────┼─────────────┼─────────────┼─────────────┼─────────────┼─────────────╮
             XXX           &kp F10       &kp F1        &kp F2        &kp F3        XXX               XXX           XXX           XXX           XXX           XXX           XXX
//         ╰─────────────┴─────────────┴─────────────┼─────────────┼─────────────┼─────────────┤   ├─────────────┼─────────────┼─────────────┼─────────────┴─────────────┴─────────────╯
                                                       XXX           &kp SPACE     &kp TAB           XXX           XXX           XXX
//                                                   ╰─────────────┴─────────────┴─────────────╯   ╰─────────────┴─────────────┴─────────────╯
    >;
};