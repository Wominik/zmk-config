brac_layer {
label = "BRAC";
    bindings = <
//                       ╭─────────────┬─────────────┬─────────────┬─────────────┬─────────────╮   ╭─────────────┬─────────────┬─────────────┬─────────────┬─────────────╮
                           XXX           XXX           &kp LPAR      &kp RPAR      XXX               XXX           XXX           XXX           XXX           XXX 
//                       ├─────────────┼─────────────┼─────────────┼─────────────┼─────────────┤   ├─────────────┼─────────────┼─────────────┼─────────────┼─────────────┤
                           &kp LT        &kp GT        &kp LBRC      &kp RBRC      XXX               RHPR          &kp RSHFT     &kp LGUI      &kp LALT      &kp RCTRL
//         ╭─────────────┼─────────────┼─────────────┼─────────────┼─────────────┼─────────────┤   ├─────────────┼─────────────┼─────────────┼─────────────┼─────────────┼─────────────╮
             &kp EQUAL     XXX           XXX           &kp LBKT      &kp RBKT      XXX               XXX           XXX           XXX           XXX           XXX           XXX
//         ╰─────────────┴─────────────┴─────────────┼─────────────┼─────────────┼─────────────┤   ├─────────────┼─────────────┼─────────────┼─────────────┴─────────────┴─────────────╯
                                                       XXX           &kp SPACE     &kp TAB           XXX           XXX           XXX
//                                                   ╰─────────────┴─────────────┴─────────────╯   ╰─────────────┴─────────────┴─────────────╯
    >;
};