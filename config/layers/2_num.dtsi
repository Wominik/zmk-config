num_layer {
label = "NUM";
    bindings = <
//                       ╭─────────────┬─────────────┬─────────────┬─────────────┬─────────────╮   ╭─────────────┬─────────────┬─────────────┬─────────────┬─────────────╮
                           XXX           XXX           XXX           XXX           XXX               XXX           &kp N7        &kp N8        &kp N9        &kp MINUS 
//                       ├─────────────┼─────────────┼─────────────┼─────────────┼─────────────┤   ├─────────────┼─────────────┼─────────────┼─────────────┼─────────────┤
                           &kp LGUI      &kp LALT      &kp LCTRL     &kp LSHFT     LHPR              XXX           &kp N4        &kp N5        &kp N5        &kp PLUS
//         ╭─────────────┼─────────────┼─────────────┼─────────────┼─────────────┼─────────────┤   ├─────────────┼─────────────┼─────────────┼─────────────┼─────────────┼─────────────╮
             XXX           XXX           XXX           XXX           XXX           XXX               &kp N0        &kp N1        &kp N2        &kp N3        &kp BSLH      &kp EQUAL
//         ╰─────────────┴─────────────┴─────────────┼─────────────┼─────────────┼─────────────┤   ├─────────────┼─────────────┼─────────────┼─────────────┴─────────────┴─────────────╯
                                                       XXX           XXX           XXX               &kp BSPC      &kp SPACE     ___
//                                                   ╰─────────────┴─────────────┴─────────────╯   ╰─────────────┴─────────────┴─────────────╯
    >;
};
