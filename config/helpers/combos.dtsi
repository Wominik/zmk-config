/*                   KEY POSITIONS
    ╭──────────────────────┬─────────────────────╮
    │  LT4 LT3 LT2 LT1 LT0 │ RT0 RT1 RT2 RT3 RT4 │
 ╭──╯  LM4 LM3 LM2 LM1 LM0 │ RM0 RM1 RM2 RM3 RM4 ╰───╮
 │ LB5 LB4 LB3 LB2 LB1 LB0 │ RB0 RB1 RB2 RB3 RB4 RB5 │
 ╰──────────╮  LH2 LH1 LH0 │ RH0 RH1 RH2 ╭───────────╯
            ╰──────────────┴─────────────╯

*/

combos {
    compatible = "zmk,combos";
    combo_esc {
        timeout-ms = <50>;
        key-positions = <LM4 LM3>;
        bindings = <&mt LC(LALT) ESC>;
    };
    combo_tab {
        timeout-ms = <50>;
        key-positions = <LM2 LM1>;
        bindings = <&mt LS(LGUI) TAB>;
    };
    combo_ent {
        timeout-ms = <50>;
        key-positions = <RM1 RM2>;
        bindings = <&mt RS(RGUI) ENTER>;
    };
};
